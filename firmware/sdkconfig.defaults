## firmware/sdkconfig.defaults
```kconfig
CONFIG_IDF_TARGET="esp32c3"

# Use the built-in USB Serial/JTAG for console + flashing
CONFIG_ESP_CONSOLE_USB_SERIAL_JTAG=y

# Bluetooth / NimBLE (ESP32-C3 supports BLE only, no classic)
CONFIG_BT_ENABLED=y
CONFIG_BT_NIMBLE_ENABLED=y
CONFIG_BT_NIMBLE_ROLE_PERIPHERAL=y
CONFIG_BT_NIMBLE_ROLE_BROADCASTER=n
CONFIG_BT_NIMBLE_ROLE_CENTRAL=n
CONFIG_BT_NIMBLE_ROLE_OBSERVER=n
CONFIG_BT_NIMBLE_MAX_CONNECTIONS=1

# Larger ATT MTU so our CSV strings fit in one notify packet
CONFIG_BT_NIMBLE_ATT_PREFERRED_MTU=247
```
